## conf/machine/et10000.conf
```bitbake
#@TYPE: Machine
#@NAME: Xtrend et10000
#@DESCRIPTION: Machine configuration for the Xtrend et10000

MACHINE_FEATURES += "dvb-c blindscan-dvbc transcoding"

CHIPSET = "bcm7425"

require conf/machine/include/etxx00-2g.inc
```

## conf/machine/et6x00.conf
```bitbake
#@TYPE: Machine
#@NAME: Xtrend et6x00
#@DESCRIPTION: Machine configuration for the Xtrend et6x00

CHIPSET = "bcm7413"

MACHINE_FEATURES += "blindscan-dvbs"

require conf/machine/include/etxx00.inc
```

## conf/machine/et7x00.conf
```bitbake
#@TYPE: Machine
#@NAME: Xtrend et7x00
#@DESCRIPTION: Machine configuration for the Xtrend et7x00

CHIPSET = "bcm7362"
TARGET_FPU = "hard"

MACHINE_FEATURES += "textlcd dvb-c blindscan-dvbc"
MACHINE_KERNEL_PR = "r0"

require conf/machine/include/et7k.inc
```
